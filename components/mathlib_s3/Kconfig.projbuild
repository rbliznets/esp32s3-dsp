## components/mathlib_s3/Kconfig.projbuild
```kconfig
menu "mathlib_s3"

    config CHECK_PARAM
        bool "Enable check fuction param."
        default n
        help
            Disable for benchmark.

       
endmenu
```
